## examples/serproxy/Kconfig
```kconfig
#
# For a description of the syntax of this configuration file,
# see the file kconfig-language.txt in the NuttX tools repository.
#

config EXAMPLES_SERPROXY
	tristate "Serial proxy example"
	default n
	---help---
		Enable the serial proxy example

if EXAMPLES_SERPROXY
endif
```

## examples/serrelay/Kconfig
```kconfig
#
# For a description of the syntax of this configuration file,
# see the file kconfig-language.txt in the NuttX tools repository.
#

config EXAMPLES_SERRELAY
	tristate "Serial relay example"
	default n
	---help---
		Enable the serial relay example

if EXAMPLES_SERRELAY
endif
```

## examples/sertest/Kconfig
```kconfig
#
# For a description of the syntax of this configuration file,
# see the file kconfig-language.txt in the NuttX tools repository.
#

config EXAMPLES_SERTEST
	tristate "Serial test example"
	default n
	---help---
		Enable the serial test example

if EXAMPLES_SERTEST
endif
```
